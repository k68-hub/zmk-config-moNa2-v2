## boards/shields/mona2/Kconfig.shield
```kconfig
config SHIELD_MONA2_R
    def_bool $(shields_list_contains,mona2_r)

config SHIELD_MONA2_L
    def_bool $(shields_list_contains,mona2_l)

if SHIELD_MONA2_R || SHIELD_MONA2_L

config INPUT_PROCESSOR_ROTATE_20
    bool "ZMK 20-degree rotation input processor"
    default y if ZMK_POINTING

endif
```

## boards/shields/mona2/dts/bindings/zmk,input-processor-rotate-20.yaml
```yaml
description: ZMK 20-degree rotation input processor

compatible: "zmk,input-processor-rotate-20"

properties:
  "#input-processor-cells":
    type: int
    const: 0
  
  track-remainders:
    type: boolean
    description: Track remainders for smoother input
```

## boards/shields/mona2/dts/bindings/zmk,input-processor-rotate-20deg.yaml
```yaml
description: ZMK 20 degree rotation input processor

compatible: "zmk,input-processor-rotate-20deg"

properties:
  "#input-processor-cells":
    type: int
    required: true
    const: 0
```
